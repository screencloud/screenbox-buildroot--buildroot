## intel-mediadriver/Config.in
```kconfig
config BR2_PACKAGE_INTEL_MEDIADRIVER
	bool "intel-mediadriver"
	depends on BR2_PACKAGE_LIBVA
	help
	  Intel VAAPI driver for Gen8+ GPUs (Broadwell and newer, including N100 Xe).
```

## package/python-awscrt/Config.in
```kconfig
config BR2_PACKAGE_PYTHON_AWSCRT
	bool "python-awscrt"
	depends on BR2_PACKAGE_OPENSSL
	help
	  A common runtime for AWS Python projects.

	  https://github.com/awslabs/aws-crt-python
```

## package/python-chrome-devtools-protocol/Config.in
```kconfig
config BR2_PACKAGE_PYTHON_CHROME_DEVTOOLS_PROTOCOL
	bool "python-chrome-devtools-protocol"
	select BR2_PACKAGE_PYTHON_DEPRECATED # runtime
	help
	  Python type wrappers for Chrome DevTools Protocol (CDP).

	  https://github.com/hyperiongray/python-chrome-devtools-protocol
```
